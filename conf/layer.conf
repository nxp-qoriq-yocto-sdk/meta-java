## conf/layer.conf
```bitbake
# We have a conf and classes directory, append to BBPATH
BBPATH .= ":${LAYERDIR}"

# We have a recipes directory, add to BBFILES
BBFILES += "${LAYERDIR}/recipes*/*/*.bb ${LAYERDIR}/recipes*/*/*.bbappend"

BBFILE_COLLECTIONS += "meta-java"
BBFILE_PATTERN_meta-java := "^${LAYERDIR}/"
BBFILE_PRIORITY_meta-java = "10"

QEMU_TARGETS_append_pn-qemu-native = " ppc64"

PREFERRED_PROVIDER_virtual/java-native ?= "jamvm-native"
PREFERRED_PROVIDER_virtual/java-initial ?= "jamvm-initial-native"
PREFERRED_PROVIDER_openjdk-6-jre ?= "openjdk-6-jre"

PREFERRED_VERSION_icedtea6-native ?= "1.8.11"
PREFERRED_VERSION_openjdk-6-jre ?= "6b27-1.12.8"
```
